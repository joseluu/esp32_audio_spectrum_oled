#include <stdint.h>
#include <stdlib.h>
#include "freertos/FreeRTOS.h"
#include "freertos/task.h"
#include "driver/i2s_std.h"
#include "driver/gpio.h"
#include "esp_check.h"
#include "sdkconfig.h"
#include "i2s_example_pins.h"
#include <arduinoFFT.h>   // v2.04 ArduinoFFT by Enrique Condes
#include <SSD1306Wire.h>  // v4.6.1  specific version for esp32 https://github.com/ThingPulse/esp8266-oled-ssd1306

// Audio spectrum display on EPS32 Heltec WifiKit oled

// uses an INMP441 module

// Wiring up the INMP441      ESP32 -- https://www.passion-radio.fr/img/cms/wifi-kit-32-pinout.png
// INMP441	ESP32	Info
// VDD	    3v3	  Power - DO NOT USE 5V!
// GND	    GND	  GND
// see include i2s_example_pins.h
// L/R	    GND	  Left channel or right channel
// SD	      26	  Serial data
// WS	      19	  Left right clock
// SCK	    22	  Serial clock
// see https://github.com/atomic14/esp32-i2s-mic-test
// see https://invensense.tdk.com/wp-content/uploads/2015/02/INMP441.pdf


#define EXAMPLE_STD_BCLK_IO2        EXAMPLE_I2S_BCLK_IO2     // I2S bit clock io number
#define EXAMPLE_STD_WS_IO2          EXAMPLE_I2S_WS_IO2     // I2S word select io number
#define EXAMPLE_STD_DOUT_IO2        EXAMPLE_I2S_DOUT_IO2     // I2S data out io number
#define EXAMPLE_STD_DIN_IO2         EXAMPLE_I2S_DIN_IO2     // I2S data in io number

// for left channel tie the L/R pin low
#define I2S_MIC_CHANNEL  I2S_STD_SLOT_RIGHT
// either wire your microphone to the same pins or change these to match your wiring

#define I2S_MIC_SERIAL_DATA GPIO_NUM_21
#define I2S_MIC_LEFT_RIGHT_CLOCK GPIO_NUM_22
#define I2S_MIC_SERIAL_CLOCK GPIO_NUM_26
// you shouldn't need to change these settings
#define SAMPLE_BUFFER_SIZE 512
#define SAMPLE_RATE 8000

static i2s_chan_handle_t                rx_chan;        // I2S rx channel handler

// HelTec ESP32 DevKit parameters
#define D3 4
#define D5 15
SSD1306Wire  oled(0x3c, D3, D5);


float vReal[SAMPLE_BUFFER_SIZE];
float sReal[SAMPLE_BUFFER_SIZE];
float vImag[SAMPLE_BUFFER_SIZE];

#define SCL_INDEX 0x00
#define SCL_TIME 0x01
#define SCL_FREQUENCY 0x02
#define SCL_PLOT 0x03

typedef union {
  float f;
  struct {
    unsigned int mantisa : 23;
    unsigned int exponent : 8;
    unsigned int sign : 1;
  } parts;
} float_cast;

ArduinoFFT<float> FFT = ArduinoFFT<float>(vReal, vImag, SAMPLE_BUFFER_SIZE, SAMPLE_RATE);

static void i2s_example_init_std_simplex(void)
{
    /* Setp 1: Determine the I2S channel configuration and allocate two channels one by one
     * The default configuration can be generated by the helper macro,
     * it only requires the I2S controller id and I2S role
     * The tx and rx channels here are registered on different I2S controller,
     * Except ESP32 and ESP32-S2, others allow to register two separate tx & rx channels on a same controller */

    i2s_chan_config_t rx_chan_cfg = I2S_CHANNEL_DEFAULT_CONFIG(I2S_NUM_AUTO, I2S_ROLE_MASTER);
    ESP_ERROR_CHECK(i2s_new_channel(&rx_chan_cfg, NULL, &rx_chan));

    /* Step 2: Setting the configurations of standard mode and initialize each channels one by one
     * The slot configuration and clock configuration can be generated by the macros
     * These two helper macros is defined in 'i2s_std.h' which can only be used in STD mode.
     * They can help to specify the slot and clock configurations for initialization or re-configuring */

    i2s_std_config_t rx_std_cfg = {
        .clk_cfg  = I2S_STD_CLK_DEFAULT_CONFIG(SAMPLE_RATE),
        .slot_cfg = I2S_STD_MSB_SLOT_DEFAULT_CONFIG(I2S_DATA_BIT_WIDTH_16BIT, I2S_SLOT_MODE_MONO),
        .gpio_cfg = {
            .mclk = I2S_GPIO_UNUSED,    // some codecs may require mclk signal, this example doesn't need it
            .bclk = EXAMPLE_STD_BCLK_IO2,
            .ws   = EXAMPLE_STD_WS_IO2,
            .dout = EXAMPLE_STD_DOUT_IO2,
            .din  = EXAMPLE_STD_DIN_IO2,
            .invert_flags = {
                .mclk_inv = false,
                .bclk_inv = false,
                .ws_inv   = false,
            },
        },
    };
    /* Default is only receiving left slot in mono mode,
     * update to right here to show how to change the default configuration */
    rx_std_cfg.slot_cfg.slot_mask = I2S_MIC_CHANNEL;
    ESP_ERROR_CHECK(i2s_channel_init_std_mode(rx_chan, &rx_std_cfg));
}

void oledSetup(void) {
  // reset OLED
  pinMode(16,OUTPUT); 
  digitalWrite(16,LOW); 
  delay(50); 
  digitalWrite(16,HIGH); 
  
  oled.init();
  oled.clear();
  oled.flipScreenVertically();
  oled.setFont(ArialMT_Plain_10);
  oled.setTextAlignment(TEXT_ALIGN_LEFT);
  oled.drawString(0 , 0, "START" );
  oled.display();
}

void setup()
{
  // we need serial output for the plotter
  Serial.begin(115200);
  // start up the I2S peripheral
  i2s_example_init_std_simplex();
  ESP_ERROR_CHECK(i2s_channel_enable(rx_chan));
  // i2s_driver_install(I2S_NUM_0, &i2s_config, 0, NULL);
  // i2s_set_pin(I2S_NUM_0, &i2s_mic_pins);
  oledSetup();
}

uint32_t raw_samples[SAMPLE_BUFFER_SIZE];
void loop()
{
  // read from the I2S device
  size_t bytes_read = 0;
  if (i2s_channel_read(rx_chan, raw_samples, sizeof(int32_t) * SAMPLE_BUFFER_SIZE, &bytes_read, 1000) != ESP_OK) {
      Serial.printf("Read Task: i2s read failed\n");
  }
  int samples_read = bytes_read / sizeof(int32_t);
  float abs_moy = 0.0;
  float moy = 0.0;
  for (int i = 0; i < SAMPLE_BUFFER_SIZE; i++){
    vReal[i] = (short)(raw_samples[i] & 0xffff); // 16 bit mode
    //vReal[i] = raw_samples[i] - (0x20000000);
    sReal[i] = vReal[i];
    abs_moy += abs(vReal[i]);
    moy += vReal[i];
    vImag[i]=0.0;
  }
  abs_moy = abs_moy / SAMPLE_BUFFER_SIZE;
  moy = moy / SAMPLE_BUFFER_SIZE;
  for (int i = 0; i < SAMPLE_BUFFER_SIZE; i++){
    vReal[i] -= moy;
  }
  FFT.windowing(FFTWindow::Hamming, FFTDirection::Forward);	/* Weigh data */
  float moy2 = 0.0;
  for (int i = 0; i < SAMPLE_BUFFER_SIZE; i++){
    moy2 += vReal[i];
  }
  for (int i = 0; i < SAMPLE_BUFFER_SIZE; i++){
    vReal[i] -= moy2;
  }
  FFT.compute(FFTDirection::Forward); /* Compute FFT */
  FFT.complexToMagnitude(); /* Compute magnitudes */

  float x = FFT.majorPeakParabola();
  //Serial.printf("abs_moy: %6.2f moy: %6.2f moy2: %6.2f f peak: %5.0f\n", abs_moy, moy, moy2, x);

  // float_cast d1, d2;
  // d1.f = 1.0f;
  // d2.f = log10f_fast(abs_moy);
  // Serial.printf("sign = %x exponent = %3d mantisa = %x  abs_moy = %6.2f sign = %x exponent = %3d mantisa = %x\n", 
  //             d1.parts.sign, d1.parts.exponent, d1.parts.mantisa, abs_moy,
  //             d2.parts.sign, d2.parts.exponent, d2.parts.mantisa);
  float max = -1.0e18;
  float min = 1.0e18;
  int imax = 0;
  int imin = 0;
  for (int i = 0; i < samples_read; i++)
  {
    if (sReal[i] > max){
      max = sReal[i];
      imax = i;
    }
    if (sReal[i] < min){
      min = sReal[i];
      imin = i;
    }
  }
  float db_value = 50 + log10f_fast(abs_moy) *10;
  float dbn_value = log10f_fast(moy) *10;
  Serial.printf("abs_moy: %6.2f log10(abs_moy): %6.2f log10(moy): %6.2f min: %6.2f max: %6.2f minsample: %08x %10d maxsample: %08x %9d\n", 
        abs_moy, db_value, dbn_value, min, max, raw_samples[imin]- (0x20000000), raw_samples[imax]- (0x20000000));


// dump the samples out to the serial channel.
  oled.clear();
  for (int i = 20; i < samples_read; i+=2)
  {
    float m = 0;
    float vReal_value = (vReal[i]+vReal[i+1])/2;
    float vReal_db_value = (-4 + log10f_fast(vReal_value)) *20; // in db, needs offset for  display
    oled.setPixelColor(i/2, 54 - vReal_db_value, WHITE); //54 - vReal_db_value
  }
  oled.drawProgressBar(0 , 60, 128, 4, db_value);
  oled.display();
  // if (moy > 1.0){
  //   Serial.printf("max: %5.2f ", max);
  //   Serial.println("Computed magnitudes:");
  //   PrintVector(vReal, (samples_read >> 1), SCL_FREQUENCY);
  //   while(1); /* Run Once */
  // }
}


void PrintVector(float *vData, uint16_t bufferSize, uint8_t scaleType)
{
  for (uint16_t i = 0; i < bufferSize; i++)
  {
    float abscissa;
    /* Print abscissa value */
    switch (scaleType)
    {
      case SCL_INDEX:
        abscissa = (i * 1.0);
	break;
      case SCL_TIME:
        abscissa = ((i * 1.0) / 8000);
	break;
      case SCL_FREQUENCY:
        abscissa = ((i * 1.0 * 8000) / 512);
	break;
    }
    Serial.print(abscissa, 2);
    if(scaleType==SCL_FREQUENCY)
      Serial.print("Hz");
    Serial.print(" ");
    Serial.println(vData[i], 4);
  }
  Serial.println();
}

/**
   Fast algorithm for log10

   This is a fast approximation to log2()
   Y = C[0]*F*F*F + C[1]*F*F + C[2]*F + C[3] + E;
   log10f is exactly log2(x)/log2(10.0f)
   Math_log10f_fast(x) =(log2f_approx(x)*0.3010299956639812f)

   @param X number want log10 for
   @return log10(x)
*/
float log10f_fast(float X) {
  float Y, F;
  int E;
  F = frexpf(fabsf(X), &E);
  Y = 1.23149591368684f;
  Y *= F;
  Y += -4.11852516267426f;
  Y *= F;
  Y += 6.02197014179219f;
  Y *= F;
  Y += -3.13396450166353f;
  Y += E;
  return (Y * 0.3010299956639812f);
}

